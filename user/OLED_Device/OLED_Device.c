/*********************************OWL-IOT32*********************************                                      
 
	                         \\\|///
                       \\  - -  //
                        (  @ @  )
+---------------------oOOo-(_)-oOOo-------------------------+
|                                                           |
|                             Oooo                          |
+-----------------------oooO--(   )-------------------------+
                       (   )   ) /
                        \ (   (_/
                         \_)           
***************************************************************************/
#include "OLED_Device.h"
#include "SPI_driver.h"
#include "SysTick.h"
#include "usart_driver.h"

/**********************************************************
**************************引脚定义*************************
**SCLK(SCL)----->GPIOC4
**MOSI(SDA)----->GPIOC5
**RESET--------->GPIOB0
**D/C----------->GPIOB1
***********************************************************/

#define OLED_RESET_LOW()		GPIO_ResetBits(GPIOB, GPIO_Pin_0)	//低电平复位
#define OLED_RESET_HIGH()		GPIO_SetBits(GPIOB, GPIO_Pin_0)

#define OLED_CMD_MODE()			GPIO_ResetBits(GPIOB, GPIO_Pin_1)		//命令模式
#define OLED_DATA_MODE()		GPIO_SetBits(GPIOB, GPIO_Pin_1)			//数据模式


#define X_WIDTH 128
#define Y_WIDTH 64


const unsigned char F6x8[][6] =
{
    { 0x00, 0x00, 0x00, 0x00, 0x00, 0x00 },   // sp
    { 0x00, 0x00, 0x00, 0x2f, 0x00, 0x00 },   // !
    { 0x00, 0x00, 0x07, 0x00, 0x07, 0x00 },   // "
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    { 0x14, 0x14, 0x14, 0x14, 0x14, 0x14 }    // horiz lines
};

//======================================================
// 128X64I液晶底层驱动[8X16]字体库
// 设计者: powerint
// 描  述: [8X16]西文字符的字模数据 (纵向取模,字节倒序)
// !"#$%&'()*+,-./0123456789:;<=>?@ABCDEFGHIJKLMNOPQRSTUVWXYZ[\]^_`abcdefghijklmnopqrstuvwxyz{|}~
//======================================================

const unsigned char F8X16[]=
{
  0x00,0x00,0x00,0x00,0x00,0x00,0x00,0x00,0x00,0x00,0x00,0x00,0x00,0x00,0x00,0x00,// 0
  0x00,0x00,0x00,0xF8,0x00,0x00,0x00,0x00,0x00,0x00,0x00,0x33,0x30,0x00,0x00,0x00,//!1
  0x00,0x10,0x0C,0x06,0x10,0x0C,0x06,0x00,0x00,0x00,0x00,0x00,0x00,0x00,0x00,0x00,//"2
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  0x00,0x06,0x01,0x01,0x02,0x02,0x04,0x04,0x00,0x00,0x00,0x00,0x00,0x00,0x00,0x00,//~94

};

void OLED_GPIO_InitConfig(void)
{
	GPIO_InitTypeDef GPIO_InitStructure;
	RCC_APB2PeriphClockCmd(RCC_APB2Periph_GPIOB,ENABLE); 
	
	GPIO_InitStructure.GPIO_Pin = GPIO_Pin_0|GPIO_Pin_1;
	GPIO_InitStructure.GPIO_Speed = GPIO_Speed_50MHz;
	GPIO_InitStructure.GPIO_Mode = GPIO_Mode_Out_PP;
	GPIO_Init(GPIOB, &GPIO_InitStructure);
	
	OLED_RESET_HIGH();
}

/********************************************************************
**函数功能：OLED写数据函数
*********************************************************************/
void LCD_WrDat(unsigned char dat)
{
	OLED_DATA_MODE();
	OLED_SPI_WriterByte(dat);
}
/********************************************************************
**函数功能：OLED写命令函数
*********************************************************************/
void LCD_WrCmd(unsigned char cmd)
{
	OLED_CMD_MODE();
	OLED_SPI_WriterByte(cmd);
}

/********************************************************************
**函数功能：OLED延时函数
*********************************************************************/
void LCD_DLY_ms(unsigned int ms)
{
	delay_ms(ms);
}

/********************************************************************
**函数功能：OLED复位
*********************************************************************/
void LCD_Reset(void)
{
	OLED_RESET_HIGH();
	LCD_DLY_ms(100);
	OLED_RESET_LOW();
	LCD_DLY_ms(100);
	#if 1
	OLED_RESET_HIGH();
	#endif
}


void LCD_Set_Pos(unsigned char x, unsigned char y)
{ 
	LCD_WrCmd(0xb0+y);
	LCD_WrCmd(((x&0xf0)>>4)|0x10);
	LCD_WrCmd((x&0x0f)|0x00); 
}




void LCD_Fill(unsigned char bmp_dat)
{
	unsigned char y,x;

	for(y=0;y<8;y++)
	{
		LCD_WrCmd(0xb0+y);
		LCD_WrCmd(0x01);
		LCD_WrCmd(0x10);
		for(x=0;x<X_WIDTH;x++)
			LCD_WrDat(bmp_dat);
	}
}



void LCD_CLS(void)
{
	unsigned char y,x;
	
	for(y=0;y<8;y++)
	{
		LCD_WrCmd(0xb0+y);
		LCD_WrCmd(0x01);
		LCD_WrCmd(0x10); 
		for(x=0;x<X_WIDTH;x++)
			LCD_WrDat(0);
	}
}



void LCD_Init(void)        
{
	printf("LCD_Init()\r\n");
	OLED_GPIO_InitConfig();

	LCD_Reset();

	//从上电到下面开始初始化要有足够的时间，即等待RC复位完毕   
	LCD_WrCmd(0xAE);//--turn off oled panel
	LCD_WrCmd(0x00);//---set low column address
	LCD_WrCmd(0x10);//---set high column address
	LCD_WrCmd(0x40);//--set start line address  Set Mapping RAM Display Start Line (0x00~0x3F)
	LCD_WrCmd(0x81);//--set contrast control register
	LCD_WrCmd(0xCF); // Set SEG Output Current Brightness
	LCD_WrCmd(0xA1);//--Set SEG/Column Mapping     0xa0左右反置 0xa1正常
	LCD_WrCmd(0xC8);//Set COM/Row Scan Direction   0xc0上下反置 0xc8正常
	LCD_WrCmd(0xA6);//--set normal display
	LCD_WrCmd(0xA8);//--set multiplex ratio(1 to 64)
	LCD_WrCmd(0x3f);//--1/64 duty
	LCD_WrCmd(0xD3);//-set display offset	Shift Mapping RAM Counter (0x00~0x3F)
	LCD_WrCmd(0x00);//-not offset
	LCD_WrCmd(0xd5);//--set display clock divide ratio/oscillator frequency
	LCD_WrCmd(0x80);//--set divide ratio, Set Clock as 100 Frames/Sec
	LCD_WrCmd(0xD9);//--set pre-charge period
	LCD_WrCmd(0xF1);//Set Pre-Charge as 15 Clocks & Discharge as 1 Clock
	LCD_WrCmd(0xDA);//--set com pins hardware configuration
	LCD_WrCmd(0x12);
	LCD_WrCmd(0xDB);//--set vcomh
	LCD_WrCmd(0x40);//Set VCOM Deselect Level
	LCD_WrCmd(0x20);//-Set Page Addressing Mode (0x00/0x01/0x02)
	LCD_WrCmd(0x02);//
	LCD_WrCmd(0x8D);//--set Charge Pump enable/disable
	LCD_WrCmd(0x14);//--set(0x10) disable
	LCD_WrCmd(0xA4);// Disable Entire Display On (0xa4/0xa5)
	LCD_WrCmd(0xA6);// Disable Inverse Display On (0xa6/a7) 
	LCD_WrCmd(0xAF);//--turn on oled panel
	
	LCD_WrCmd(0xAF); /*display ON*/ 
	
	LCD_Fill(0x00);  //初始清屏
	LCD_Set_Pos(0,0); 
	printf("LCD_Init()++end\r\n");
}


//==============================================================
//函数名：LCD_P6x8Str(unsigned char x,unsigned char y,unsigned char *p)
//功能描述：写入一组标准ASCII字符串
//参数：显示的位置（x,y），y为页范围0～7，要显示的字符串
//返回：无
//==============================================================  
void LCD_P6x8Str(unsigned char x,unsigned char y,unsigned char ch[])
{
	unsigned char c=0,i=0,j=0;
	
	while (ch[j]!='\0')
	{    
		c =ch[j]-32;
		if(x>126){x=0;y++;}
			LCD_Set_Pos(x,y);
		
		for(i=0;i<6;i++)
			LCD_WrDat(F6x8[c][i]);
		
		x+=6;
		j++;
	}
}

//==============================================================
//函数名：LCD_P8x16Str(unsigned char x,unsigned char y,unsigned char *p)
//功能描述：写入一组标准ASCII字符串
//参数：显示的位置（x,y），y为页范围0～7，要显示的字符串
//返回：无
//============================================================== 
 
void LCD_P8x16Str(unsigned char x,unsigned char y,unsigned char ch[])
{
	unsigned char c=0,i=0,j=0;

	while (ch[j]!='\0')
	{    
		c =ch[j]-32;
		if(x>120){x=0;y++;}
			LCD_Set_Pos(x,y);
		
		for(i=0;i<8;i++)     
			LCD_WrDat(F8X16[c*16+i]);
		
		LCD_Set_Pos(x,y+1);
		
		for(i=0;i<8;i++)     
			LCD_WrDat(F8X16[c*16+i+8]);
		
		x+=8;
		j++;
	}
}

//==============================================================
//函数名： Draw_BMP(uint8_t x0,uint8_t y0,uint8_t x1,uint8_t y1,uint8_t bmp[])
//功能描述：显示BMP图片128×64
//参数：起始点坐标(x0,y0),x的范围0～128，y为页的范围0～7
//		结束点坐标(x1,y1),x的范围0～128，y为页的范围0～7
//返回：无
//==============================================================

void Draw_BMP(uint8_t x0,uint8_t y0,uint8_t x1,uint8_t y1,uint8_t bmp[])
{ 	
  int ii=0;
  uint8_t x,y;
  
  if(y1%8==0) y=y1/8;      
  else y=y1/8+1;
	
	for(y=y0;y<=y1;y++)
	{
		LCD_Set_Pos(x0,y);				
		for(x=x0;x<x1;x++)
	    {      
	    	LCD_WrDat(bmp[ii++]);	    	
	    }
	}
}

